## CMakeLists.txt
```
# SPDX-License-Identifier: Apache-2.0

cmake_minimum_required(VERSION 3.20.0)

find_package(Zephyr REQUIRED HINTS $ENV{ZEPHYR_BASE})
project(r5_zephyr_debug_demo)

target_sources(app PRIVATE
  src/main.c
  src/workers.c
  src/gic_warm_restart.c
)
```

## Kconfig
```
# SPDX-License-Identifier: Apache-2.0
#
# Both symbols below are promptless, so they cannot be set from prj.conf or from
# a snippet .conf — they need a default here, in the application's Kconfig root.

# A bare `bool` in zephyr/modules/segger/Kconfig with no default and no
# dependencies. No Cortex-A/R SoC upstream selects it, so USE_SEGGER_RTT has an
# unmet dependency and is dropped from the configuration in silence, taking
# RTT_CONSOLE with it and leaving the jtag-console snippet with no console at all.
config HAS_SEGGER_RTT
	default y

# A core parked in WFI cannot answer the probe's RTT reads: the probe halts it to
# poll the ring buffer, and gdb reports that halt as SIGTRAP, which stops the
# program. The hook lets z_arm_on_enter_cpu_idle() return false and spin instead.
# Costs idle power, so it follows RTT_CONSOLE and is absent from a uart0 build.
config ARM_ON_ENTER_CPU_IDLE_HOOK
	default y if RTT_CONSOLE

source "Kconfig.zephyr"
```

## prj.conf
```kconfig
# Console-agnostic configuration. The console backend comes from a snippet:
#   west build -b kv260_r5 . -S jtag-console    # SEGGER RTT over the probe
#   west build -b kv260_r5 . -S uart0-console   # PS UART0

CONFIG_CONSOLE=y
CONFIG_PRINTK=y
CONFIG_STDOUT_CONSOLE=y

# Source-level debugging. DEBUG_THREAD_INFO is not optional for the gdbforge
# zephyr profile: it emits the _kernel_thread_info_* offset tables the debug
# server walks to turn Zephyr threads into GDB threads. Without it both
# JLinkGDBServer and OpenOCD report a single hardware context.
CONFIG_DEBUG=y
CONFIG_DEBUG_OPTIMIZATIONS=y
CONFIG_DEBUG_THREAD_INFO=y
CONFIG_THREAD_NAME=y
CONFIG_THREAD_MONITOR=y
CONFIG_ASSERT=y

# Checks stay, messages go. This is a hard size constraint, not a preference:
# the ARMv7-R MPU can only describe power-of-two regions, so the linker rounds
# text+rodata up to one (MPU_ALIGN in the cortex_a_r linker script) and data and
# bss start after it. The verbose assert strings take rodata from 26,784 to
# 34,880 bytes, which crosses 32K, so the ROM region rounds to 64K and consumes
# the entire ATCM - the link then fails with "region RAM overflowed". Leaving it
# off keeps the ROM region at 32K with roughly 6K to spare, and the upper 32K
# free for data and bss. An assert still halts the core, which is what you want
# with a debugger attached anyway.
CONFIG_ASSERT_VERBOSE=n

# -Og, not -O0. CONFIG_NO_OPTIMIZATIONS=y gives better stepping but adds text,
# and per the note above there is only so much room before the ROM region
# doubles. Try it with -DCONFIG_NO_OPTIMIZATIONS=y on the build line.

# ARM mode throughout. The RPU vector table and the reset path are ARM, and
# mixing in Thumb-2 for the application buys nothing here.
CONFIG_COMPILER_ISA_THUMB2=n

# TTC0, not the ARM architected timer: psu_init only releases TTC0 from reset
# (RST_LPD_IOU2 bit 11). The driver picks its instance from the first enabled
# xlnx,ttcps node plus CONFIG_XLNX_PSTTC_TIMER_INDEX, and kv260_r5 enables only
# ttc0, so no chosen node is needed.
CONFIG_XLNX_PSTTC_TIMER=y
CONFIG_ARM_ARCH_TIMER=n
CONFIG_SYS_CLOCK_EXISTS=y
CONFIG_SYS_CLOCK_HW_CYCLES_PER_SEC=100000000
CONFIG_SYS_CLOCK_TICKS_PER_SEC=10000
CONFIG_TICKLESS_KERNEL=n

# 4096 was tight: printf with CBPRINTF_COMPLETE on picolibc is stack-hungry.
# STACK_SENTINEL reports an overflow at the next context switch instead of
# letting it silently corrupt the neighbouring thread. It needs no MPU.
CONFIG_MAIN_STACK_SIZE=8192
CONFIG_ISR_STACK_SIZE=2048
CONFIG_IDLE_STACK_SIZE=512
CONFIG_STACK_SENTINEL=y

# No floating point anywhere, which also keeps printf off the soft-float path.
CONFIG_FPU=n
CONFIG_FPU_SHARING=n
CONFIG_PICOLIBC_IO_FLOAT=n
CONFIG_CBPRINTF_FP_SUPPORT=n

# sys_rand32_get() for the worker sleep jitter. The RPU has no entropy driver,
# so this picks TIMER_RANDOM_GENERATOR: an LCG stirred with the TTC counter.
# Fine for jitter, not for anything that needs real entropy.
CONFIG_TEST_RANDOM_GENERATOR=y
```

## boards/kv260_r5.overlay
```dts
/*
 * SPDX-License-Identifier: Apache-2.0
 *
 * The image runs from ATCM, which is 64K per core in split mode, and that is
 * all a debugger load reaches at address 0. Upstream kv260_r5.dts declares
 * sram0 as 64M, so an image that overruns the TCM links without complaint and
 * only fails on the target. Sizing sram0 to the real bank turns that into a
 * link error, and lets CONFIG_SRAM_BASE_ADDRESS / CONFIG_SRAM_SIZE come from
 * devicetree instead of being hardcoded in prj.conf.
 */

&sram0 {
	reg = <0x0 DT_SIZE_K(64)>;
};
```

## src/main.c
```c
/*
 * SPDX-License-Identifier: Apache-2.0
 *
 * Zephyr on Cortex-R5 debugging demo. Three threads (main plus two workers), a
 * shared struct behind a mutex, and a call chain deep enough to be worth a
 * backtrace.
 */

#include <zephyr/kernel.h>
#include <zephyr/init.h>
#include <zephyr/sys/printk.h>

#include "demo.h"

struct demo_stats demo_stats;
K_MUTEX_DEFINE(demo_lock);

#ifdef CONFIG_ARM_ON_ENTER_CPU_IDLE_HOOK
/*
 * Returning false makes arch_cpu_idle() skip the WFI and spin instead. A
 * sleeping core cannot answer the probe's memory reads: it halts the core to
 * poll the RTT buffer, gdb sees that halt as SIGTRAP and stops us. Costs idle
 * power, so this follows the hook, which follows RTT_CONSOLE — it is gone in a
 * uart0-console build.
 */
bool z_arm_on_enter_cpu_idle(void)
{
	return false;
}
#endif

/*
 * Boot progress marker, for breakpoints that have to fire before main().
 * Lives in .noinit, so 0 means "never got here". Each checkpoint shifts a
 * nibble in, which makes boot_stage read as a trail: 0x12345678.
 */
__attribute__((section(".noinit"), used))
volatile uint32_t boot_stage;

static inline void mark(uint32_t v)
{
	boot_stage = (boot_stage << 4) | (v & 0xf);
}

static int mk_pk1_first(void)  { mark(1); return 0; }
static int mk_pk1_last(void)   { mark(2); return 0; }
static int mk_pk2_first(void)  { mark(3); return 0; }
static int mk_pk2_last(void)   { mark(4); return 0; }
static int mk_post_first(void) { mark(5); return 0; }
static int mk_post_last(void)  { mark(6); return 0; }
static int mk_app_first(void)  { mark(7); return 0; }
static int mk_app_last(void)   { mark(8); return 0; }

/* Priority 0 runs first within a level, 99 last, so each pair brackets it. */
SYS_INIT(mk_pk1_first,  PRE_KERNEL_1, 0);
SYS_INIT(mk_pk1_last,   PRE_KERNEL_1, 99);
SYS_INIT(mk_pk2_first,  PRE_KERNEL_2, 0);
SYS_INIT(mk_pk2_last,   PRE_KERNEL_2, 99);
SYS_INIT(mk_post_first, POST_KERNEL, 0);
SYS_INIT(mk_post_last,  POST_KERNEL, 99);
SYS_INIT(mk_app_first,  APPLICATION, 0);
SYS_INIT(mk_app_last,   APPLICATION, 99);

/* Recursive on purpose: gives `bt` something to unwind and `finish` something
 * to return from. Keep n small, the stacks here are modest.
 */
static uint32_t fib(uint32_t n)
{
	if (n < 2U) {
		return n;
	}

	return fib(n - 1U) + fib(n - 2U);
}

static int32_t accumulate(int32_t acc, uint32_t term)
{
	return acc + (int32_t)term;
}

static int32_t compute_sample(uint32_t round)
{
	uint32_t depth = (round % 8U) + 2U;
	int32_t acc = 0;

	for (uint32_t i = 0; i < depth; i++) {
		acc = accumulate(acc, fib(i));
	}

	return acc;
}

/* Takes the lock, so stepping through it while a worker is waiting shows the
 * worker blocked in the Threads pane.
 */
static int32_t run_iteration(void)
{
	int32_t sample;

	k_mutex_lock(&demo_lock, K_FOREVER);
	demo_stats.iterations++;
	sample = compute_sample(demo_stats.iterations);
	demo_stats.last_sample = sample;
	k_mutex_unlock(&demo_lock);

	return sample;
}

int main(void)
{
	printk("zephyr cortex-r5 debug demo on %s\n", CONFIG_BOARD_TARGET);

	workers_start();

	while (1) {
		int32_t sample = run_iteration();

		printk("iteration %u sample %d\n", demo_stats.iterations, sample);
		k_sleep(K_MSEC(1000));
	}

	return 0;
}
```

## src/demo.h
```c
/*
 * SPDX-License-Identifier: Apache-2.0
 */

#ifndef DEMO_H
#define DEMO_H

#include <zephyr/kernel.h>
#include <stdint.h>

#define DEMO_WORKERS 2

/*
 * Shared state, written by main() and by both workers. Deliberately a plain
 * struct rather than atomics: the point is to have something a watchpoint can
 * sit on, with a mutex around it so stepping through one writer while another
 * is blocked is observable in the Threads pane.
 */
struct demo_stats {
	uint32_t iterations;
	uint32_t worker_wakeups[DEMO_WORKERS];
	int32_t last_sample;
};

extern struct demo_stats demo_stats;
extern struct k_mutex demo_lock;

void workers_start(void);

#endif /* DEMO_H */
```

## src/gic_warm_restart.c
```c
/*
 * SPDX-License-Identifier: Apache-2.0
 *
 * Retire any interrupt a warm restart left active.
 *
 * Restarting by jumping to __start with no system reset in between - which is
 * exactly what a debugger "load" followed by "set $pc = 0x0" does - can land
 * between an ISR's GICC_IAR read and its GICC_EOIR write. The CPU interface
 * keeps that interrupt's priority as the running priority, and because
 * gic_dist_init() gives every SPI priority 0, nothing is ever signalled again:
 * the timer keeps counting, its interrupt keeps going pending, and no tick is
 * ever delivered, so k_sleep() never returns.
 *
 * GICv1 has no GICD_ICACTIVERn - only the read-only active bits at 0x300 - so
 * gic_dist_init() cannot clear the state and it survives into the application,
 * where it can be read and retired. v1 has no split EOI either, so one
 * GICC_EOIR write both pops a level off the priority stack and deactivates the
 * interrupt. On a cold boot nothing reads back active and this is a no-op.
 *
 * PRE_KERNEL_1 is both late and early enough. The GIC is set up in
 * z_arm_interrupt_init(), called from z_prep_c() before z_cstart(), so the CPU
 * interface already accepts GICC_EOIR writes by the time any SYS_INIT entry
 * runs; the system timer registers at PRE_KERNEL_2, so it has not been
 * programmed yet. Interrupts are masked at the core for all of PRE_KERNEL_1, so
 * none can be taken while the priority stack unwinds.
 */

#include <zephyr/kernel.h>
#include <zephyr/init.h>

#ifdef CONFIG_GIC_V1

#include <zephyr/drivers/interrupt_controller/gic.h>
#include <zephyr/sys/sys_io.h>

/* gic.h only declares the registers the normal v1/v2 paths touch. */
#define GICC_RPR      (GIC_CPU_BASE + 0x14)
#define GICC_RPR_IDLE 0xff

static int gic_drain_active(void)
{
	unsigned int gic_irqs, i, bit;

	gic_irqs = ((sys_read32(GICD_TYPER) & GICD_TYPER_ITLINESNUM_MASK) + 1) * 32;
	if (gic_irqs > 1020) {
		gic_irqs = 1020;
	}

	for (i = 0; i < gic_irqs; i += 32) {
		uint32_t active = sys_read32(GICD_ISACTIVERn + i / 8);

		for (bit = 0; bit < 32; bit++) {
			if ((active & BIT(bit)) != 0U) {
				sys_write32(i + bit, GICC_EOIR);
			}
		}
	}

	__ASSERT(sys_read32(GICC_RPR) == GICC_RPR_IDLE,
		 "GIC CPU interface still busy at priority 0x%x; interrupts "
		 "will never be signalled", sys_read32(GICC_RPR));

	return 0;
}

SYS_INIT(gic_drain_active, PRE_KERNEL_1, 0);

#endif /* CONFIG_GIC_V1 */
```

## src/workers.c
```c
/*
 * SPDX-License-Identifier: Apache-2.0
 *
 * Two demo threads, started from main().
 */

#include <zephyr/kernel.h>
#include <zephyr/random/random.h>
#include <zephyr/sys/printk.h>

#include "demo.h"

#define WORKER_STACK_SIZE 1024
#define WORKER_PRIORITY   5

#define WORKER_DELAY_MIN_MS 1000
#define WORKER_DELAY_MAX_MS 2000

static K_THREAD_STACK_DEFINE(worker0_stack, WORKER_STACK_SIZE);
static K_THREAD_STACK_DEFINE(worker1_stack, WORKER_STACK_SIZE);

static struct k_thread worker0_data;
static struct k_thread worker1_data;

/* Marsaglia xorshift32. Never returns 0 and never reaches it from non-zero. */
static uint32_t xorshift32(uint32_t *state)
{
	uint32_t x = *state;

	x ^= x << 13;
	x ^= x >> 17;
	x ^= x << 5;
	*state = x;

	return x;
}

static void worker_entry(void *id, void *unused1, void *unused2)
{
	int slot = POINTER_TO_INT(id);
	/*
	 * Per-thread state, on this thread's own stack. Calling sys_rand32_get()
	 * in the loop instead would hand both threads alternating draws from one
	 * shared sequence, which correlates them - the whole point here is that
	 * the two delays are independent.
	 */
	uint32_t state = sys_rand32_get() | 1U;

	ARG_UNUSED(unused1);
	ARG_UNUSED(unused2);

	while (1) {
		uint32_t delay_ms = WORKER_DELAY_MIN_MS +
			xorshift32(&state) % (WORKER_DELAY_MAX_MS - WORKER_DELAY_MIN_MS + 1);

		k_mutex_lock(&demo_lock, K_FOREVER);
		demo_stats.worker_wakeups[slot]++;
		k_mutex_unlock(&demo_lock);

		printk("worker%d awake %u times (next in %u ms)\n",
		       slot, demo_stats.worker_wakeups[slot], delay_ms);
		k_sleep(K_MSEC(delay_ms));
	}
}

void workers_start(void)
{
	k_tid_t tid;

	tid = k_thread_create(&worker0_data, worker0_stack, WORKER_STACK_SIZE,
			      worker_entry, INT_TO_POINTER(0), NULL, NULL,
			      WORKER_PRIORITY, 0, K_NO_WAIT);
	/* Named, so the Threads pane shows worker0/worker1 rather than unnamed
	 * entries. Needs CONFIG_THREAD_NAME=y.
	 */
	k_thread_name_set(tid, "worker0");

	/* Staggered, so the two do not print together on the very first pass. */
	tid = k_thread_create(&worker1_data, worker1_stack, WORKER_STACK_SIZE,
			      worker_entry, INT_TO_POINTER(1), NULL, NULL,
			      WORKER_PRIORITY, 0, K_MSEC(500));
	k_thread_name_set(tid, "worker1");
}
```
