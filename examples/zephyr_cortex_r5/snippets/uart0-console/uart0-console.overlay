/*
 * SPDX-License-Identifier: Apache-2.0
 *
 * Move the console from uart1, where kv260_r5 puts it, to uart0. Both nodes are
 * disabled in zynqmp.dtsi, so uart0 has to be enabled here as well.
 */

/ {
	chosen {
		zephyr,console = &uart0;
		zephyr,shell-uart = &uart0;
	};
};

&uart0 {
	status = "okay";
	current-speed = <115200>;
	clock-frequency = <99999901>;
};

&uart1 {
	status = "disabled";
};
